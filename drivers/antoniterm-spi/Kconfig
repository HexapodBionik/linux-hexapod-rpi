## drivers/antoniterm-spi/Kconfig
```kconfig
config ANTONITERM
	tristate "ANTONITERM support"
	depends on SPI
	help
	  ANTONITERM support over SPI.
```

## drivers/hhc-spi/Kconfig
```kconfig
config HEXAPOD_HHC
	tristate "Hexapod Hardware Controller support"
	depends on SPI
	help
	  Hexapod Hardware Controller support over SPI.
```
